## drivers/platform/nexell/Kconfig
```kconfig
#
# Copyright 2009 Nexell.
#		http://www.nexell.co.kr
#
menu "Nexell SLsiAP specific device drivers"
	depends on PLAT_SLSIAP

config NXP_NXP_SETUP_CPU
	bool "Setup cpu interface"
	help
		If you say yes to this option, support will be included for the
		built-in setup cpu interface on bootup for Nexell SLsiAP processors.
```

## drivers/platform/nexell/s5p6818/Kconfig
```kconfig
#
# Copyright 2009 Nexell.
#
menu "SLsiAP s5p6818"

choice
	prompt "Prototype build mode"
	default S5P6818_PROTO_RELEASE

	config S5P6818_PROTO_RELEASE
		bool "Release"

	config S5P6818_PROTO_DEBUG
		bool "Debug"
endchoice

config S5P6818_PM_IDLE
	bool "Goto idle when Suspend"
	depends on SUSPEND
	default n

config ARCH_S5P6818_BOARD
	bool "s5p6818 Board Feactures"
	default n
	depends on ARCH_S5P6818

choice
    prompt "Type"
    default ARCH_S5P6818_SVT
    depends on ARCH_S5P6818_BOARD

   	config ARCH_S5P6818_SVT
		bool "SVT: Validation Board"
		help
   	 		Support for the Validation Board (SVT).

   	config ARCH_S5P6818_ASB
		bool "ASB: Validation Board"
		help
   	 		Support for the Validation Board (ASB).
endchoice

if ARCH_S5P6818_SVT
source "drivers/platform/nexell/s5p6818/svt/Kconfig"
endif

endmenu
```

## drivers/usb/nexell/Kconfig
```kconfig
#
# Copyright 2010 Nexell.
#
# Configuration options for the S5Pxxx USB

comment "S5PXX18 USB devices support"

config USB_NXP
	bool
	depends on PLAT_SLSIAP
	help
	  Say Y or M if you want to add support for s5pxx18 USB
```
